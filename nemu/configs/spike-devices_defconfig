## nemu/configs/spike-devices_defconfig
```kconfig
CONFIG_RV64=y
CONFIG_TARGET_SPIKE_DEVICES=y
CONFIG_CC_CLANG=y
CONFIG_CC_O3=y
CONFIG_CC_DEBUG=y
CONFIG_BREAKPOINT=y
CONFIG_DEVICE=y
# CONFIG_HAS_KEYBOARD is not set
# CONFIG_HAS_VGA is not set
# CONFIG_HAS_AUDIO is not set
# CONFIG_HAS_DISK is not set
CONFIG_TIMER_CLOCK_GETTIME=y
```
